## firmware/esp32-csi-node/sdkconfig.defaults.n16r8
```kconfig
# ESP32-S3-WROOM-1-N16R8 hardware overlay.
# Apply after sdkconfig.defaults via SDKCONFIG_DEFAULTS.

# 16 MB quad-SPI flash.
CONFIG_ESPTOOLPY_FLASHSIZE_16MB=y
CONFIG_ESPTOOLPY_FLASHSIZE="16MB"

# 8 MB octal PSRAM.
CONFIG_SPIRAM=y
CONFIG_SPIRAM_MODE_OCT=y
CONFIG_SPIRAM_TYPE_AUTO=y
CONFIG_SPIRAM_SPEED_80M=y
CONFIG_SPIRAM_USE_MALLOC=y
CONFIG_SPIRAM_MEMTEST=y
```
